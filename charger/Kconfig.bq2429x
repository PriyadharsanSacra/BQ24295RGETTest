## charger/Kconfig.bq2429x
```kconfig
# Copyright 2026 Sacra Systems Private Limited
#
# SPDX-License-Identifier: Apache-2.0

config CHARGER_BQ2429X
	bool "BQ2429X Battery Charger"
	default y
	depends on DT_HAS_TI_BQ24295_ENABLED || DT_HAS_TI_BQ24296_ENABLED || \
		DT_HAS_TI_BQ24297_ENABLED
	select I2C
	help
	  Enable BQ2429X battery charger driver.
```
